## arch/arm/configs/msm8916_sec_a5_chnopen_defconfig
```kconfig
CONFIG_SEC_A5_PROJECT=y
CONFIG_MACH_A5_CHN_OPEN=y

# GPIO SETTING
CONFIG_SEC_GPIO_SETTINGS=y

# MUIC
CONFIG_SM5502_MUIC=y
CONFIG_MUIC_SUPPORT_RUSTPROOF_INBATT=y
CONFIG_USBID_STANDARD_VER_01=y
CONFIG_MUIC_SUPPORT_CHARGING_CABLE=y

#HALL IC
CONFIG_SENSORS_HALL=y

#DISPLAY
CONFIG_PANEL_EA8061V_AMS497EE01_HD=y
CONFIG_FB_MSM_MDSS_SAMSUNG=y

#Touch Screen
CONFIG_TOUCHSCREEN_MMS300_A=y

#Touch Key
CONFIG_KEYBOARD_ABOV_TOUCH_A5=y

#Haptic Vibrator (works with A5000 too)
CONFIG_VIBETONZ=y
CONFIG_TACTILE_ASSIST=y

#BATTERY
CONFIG_MFD_RT5033=y
CONFIG_MFD_RT5033_RESET_GPIO=y
CONFIG_MFD_RT5033_SLDO_VBUSDET=n
CONFIG_BATTERY_SAMSUNG=y
CONFIG_BATTERY_SAMSUNG_DATA_FILE="a5_battery_data.h"
CONFIG_SAMSUNG_LPM_MODE=y
CONFIG_CHARGER_RT5033=y
CONFIG_FUELGAUGE_RT5033=y
CONFIG_REGULATOR_RT5033=y
CONFIG_PREVENT_SOC_JUMP=y
CONFIG_BATTERY_SWELLING=y
#CONFIG_SIOP_CHARGING_LIMIT_CURRENT=700

#SENSORS
CONFIG_SENSORS=y
CONFIG_SENSORS_CORE=y
CONFIG_SENSORS_USE_SYMLINK=y
CONFIG_INPUT=y
CONFIG_INPUT_MISC=y
CONFIG_INPUT_GPIO=y
CONFIG_INPUT_POLLDEV=y
CONFIG_SENSORS_TMD3782S=y
CONFIG_SENSORS_TMD3782S_VDD_LEDA=y
# BMC150
CONFIG_SENSORS_BMA2X2=y
CONFIG_SENSORS_BMM050=y
CONFIG_SENSORS_BMC150_VDD=y
CONFIG_SENSORS_BMA2X2_ENABLE_INT1=y
CONFIG_SENSORS_BMM050_FILTER=y
#CONFIG_SENSORS_ACCELEROMETER_2G=y

#AUDIO
#CONFIG_RADIO_IRIS=y
#CONFIG_RADIO_IRIS_TRANSPORT=m
CONFIG_AUDIO_SPEAKER_OUT_NXP_AMP_ENABLE=y
CONFIG_AUDIO_QUAT_I2S_ENABLE=y
CONFIG_SAMSUNG_JACK_WATCH_DOG_RESET_WORK_AROUND=y

#FLASH
CONFIG_FLASHLIGHT=y
CONFIG_RT_FLASH_LED=y
CONFIG_FLED_RT5033=y
CONFIG_FLED_RT5033_EXT_GPIO=y

#CAMERA
CONFIG_SEC_A5_COMMON_CAMERA=y
# SM-A500FU does this
CONFIG_MSM_OTP=y
CONFIG_IMX135=y
CONFIG_S5K5E3YX=y

#MMC
CONFIG_SEC_HYBRID_TRAY=y

#optimize mmc block delay on resume
CONFIG_MMC_BLOCK_DEFERRED_RESUME=y

#Power off Alarm
CONFIG_RTC_AUTO_PWRON=y
CONFIG_RTC_AUTO_PWRON_PARAM=y

# Bluetooth
# FIXME: not in Samsung kernel config
CONFIG_BT=y
# CONFIG_BT_RFCOMM is not set
# CONFIG_BT_RFCOMM_TTY is not set
# CONFIG_BT_BNEP is not set
# CONFIG_BT_BNEP_MC_FILTER is not set
# CONFIG_BT_BNEP_PROTO_FILTER is not set
CONFIG_BT_HIDP=y
CONFIG_BT_HCIBTUSB=y
CONFIG_BT_HCIUART=y
CONFIG_BT_HCIBCM203X=y
CONFIG_BT_HCIBPA10X=y
CONFIG_BT_HCIBFUSB=y
# CONFIG_BT_HCISMD is not set
# CONFIG_BT_HCIUART is not set
# CONFIG_BT_HCIUART_H4 is not set
CONFIG_MAC80211=y

CONFIG_HID_SUPPORT=y
CONFIG_HID=y
CONFIG_HIDRAW=y

# Special HID drivers
# TODO: Do I actually need any of these?
CONFIG_HID_A4TECH=y
CONFIG_HID_ACRUX=y
# CONFIG_HID_ACRUX_FF is not set
CONFIG_HID_APPLE=y
CONFIG_HID_BELKIN=y
CONFIG_HID_CHERRY=y
CONFIG_HID_CHICONY=y
CONFIG_HID_PRODIKEYS=y
CONFIG_HID_CYPRESS=y
CONFIG_HID_DRAGONRISE=y
CONFIG_HID_EMS_FF=y
CONFIG_HID_ELECOM=y
CONFIG_HID_EZKEY=y
CONFIG_HID_KEYTOUCH=y
CONFIG_HID_KYE=y
CONFIG_HID_UCLOGIC=y
CONFIG_HID_WALTOP=y
CONFIG_HID_GYRATION=y
CONFIG_HID_TWINHAN=y
CONFIG_HID_KENSINGTON=y
CONFIG_HID_LCPOWER=y
CONFIG_HID_LOGITECH=y
CONFIG_HID_MAGICMOUSE=y
CONFIG_HID_MICROSOFT=y
CONFIG_HID_MONTEREY=y
CONFIG_HID_MULTITOUCH=y
CONFIG_HID_NTRIG=y
CONFIG_HID_ORTEK=y
CONFIG_HID_PANTHERLORD=y
CONFIG_HID_PETALYNX=y
CONFIG_HID_PICOLCD=y
# CONFIG_HID_PICOLCD_FB is not set
# CONFIG_HID_PICOLCD_BACKLIGHT is not set
# CONFIG_HID_PICOLCD_LCD is not set
# CONFIG_HID_PICOLCD_LEDS is not set
CONFIG_HID_QUANTA=y
CONFIG_HID_ROCCAT=y
CONFIG_HID_ROCCAT_COMMON=y
CONFIG_HID_ROCCAT_ARVO=y
CONFIG_HID_ROCCAT_KONE=y
CONFIG_HID_ROCCAT_KONEPLUS=y
CONFIG_HID_ROCCAT_KOVAPLUS=y
CONFIG_HID_ROCCAT_PYRA=y
CONFIG_HID_SAMSUNG=y
CONFIG_HID_SYNAPTICS_BT=y
CONFIG_HID_SONY=y
CONFIG_HID_SUNPLUS=y
CONFIG_HID_GREENASIA=y
CONFIG_HID_SMARTJOYPLUS=y
CONFIG_HID_TOPSEED=y
CONFIG_HID_THRUSTMASTER=y
CONFIG_HID_WACOM=y
CONFIG_HID_WACOM_POWER_SUPPLY=y
CONFIG_HID_ZAGG=y
CONFIG_HID_ZEROPLUS=y
CONFIG_HID_ZYDACRON=y

# SSWAP
CONFIG_SWAP=y
CONFIG_FRONTSWAP=y
CONFIG_ZSMALLOC=y
CONFIG_PGTABLE_MAPPING=y
CONFIG_ZSWAP=y
CONFIG_DIRECT_RECLAIM_FILE_PAGES_ONLY=y
CONFIG_INCREASE_MAXIMUM_SWAPPINESS=y
CONFIG_FIX_INACTIVE_RATIO=y
CONFIG_TIGHT_PGDAT_BALANCE=y
CONFIG_VNSWAP=y
CONFIG_SWAP_ENABLE_READAHEAD=n

# ZRAM
# CONFIG_ZRAM is not set
CONFIG_ZRAM_LZ4_COMPRESS=y

# FAST CHARGE
# CONFIG_FORCE_FAST_CHARGE is not set

# DEBUG
#CONFIG_TRACE_MODEM_MEM_FAIL=y
# HARD RESET
CONFIG_RESTART_REASON_SEC_PARAM=y

#IPSec
CONFIG_CRYPTO_NULL=y

# nethunter
# I don't really care
#CONFIG_USB_RTL8150=y
#CONFIG_USB_RTL8152=y
#CONFIG_AT76C50X_USB=y
#CONFIG_USB_ZD1201=y
#CONFIG_USB_NET_RNDIS_WLAN=y
#CONFIG_RTL8187=y
#CONFIG_ATH_CARDS=y
#CONFIG_ATH9K=y
#CONFIG_ATH9K_AHB=y
#CONFIG_ATH9K_LEGACY_RATE_CONTROL=y
#CONFIG_ATH9K_HTC=y
#CONFIG_CARL9170=y
#CONFIG_CARL9170_HWRNG=y
#CONFIG_ATH6KL=y
#CONFIG_ATH6KL_USB=y
#CONFIG_AR5523=y
#CONFIG_RT2X00=y
#CONFIG_RT2500USB=y
#CONFIG_RT73USB=y
#CONFIG_RT2800USB=y
#CONFIG_RT2800USB_RT53XX=y
#CONFIG_RT2800USB_RT55XX=y
#CONFIG_RT2800USB_UNKNOWN=y
#CONFIG_RTLWIFI=y
#CONFIG_RTL8192CU=y
#CONFIG_MEDIA_DIGITAL_TV_SUPPORT=y

# WireGuard
# I don't really care
# CONFIG_WIREGUARD is not set
# CONFIG_WIREGUARD_DEBUG is not set
```

## arch/arm/configs/msm8916_sec_a5u_eur_twrp_defconfig
```kconfig
CONFIG_SEC_A5_PROJECT=y
CONFIG_MACH_A5U_EUR_OPEN=y

# HARD RESET
CONFIG_RESTART_REASON_SEC_PARAM=y

# GPIO SETTING
CONFIG_SEC_GPIO_SETTINGS=y

# MUIC
CONFIG_SM5502_MUIC=y
CONFIG_MUIC_SUPPORT_RUSTPROOF_INBATT=y
CONFIG_USBID_STANDARD_VER_01=y
CONFIG_MUIC_SUPPORT_CHARGING_CABLE=y

#HALL IC
CONFIG_SENSORS_HALL=y
#Touch Key
CONFIG_KEYBOARD_ABOV_TOUCH_A5=y

#Touch Screen
CONFIG_TOUCHSCREEN_MMS300_A=y

#Haptic Vibrator
CONFIG_VIBETONZ=y
CONFIG_TACTILE_ASSIST=y

#SENSORS
CONFIG_SENSORS=y
CONFIG_SENSORS_CORE=y
CONFIG_SENSORS_USE_SYMLINK=y
CONFIG_INPUT=y
CONFIG_INPUT_MISC=y
CONFIG_INPUT_GPIO=y
CONFIG_INPUT_POLLDEV=y
CONFIG_SENSORS_TMD3782S=y
CONFIG_SENSORS_TMD3782S_VDD_LEDA=y
# BMC150
CONFIG_SENSORS_BMA2X2=y
CONFIG_SENSORS_BMM050=y
CONFIG_SENSORS_BMA2X2_ENABLE_INT1=y
CONFIG_SENSORS_BMC150_VDD=y
CONFIG_MSM_OTP=y

#DISPLAY
CONFIG_PANEL_EA8061V_AMS497EE01_HD=y

#optimize mmc block delay on resume
CONFIG_MMC_BLOCK_DEFERRED_RESUME=y

#BATTERY
CONFIG_MFD_RT5033=y
CONFIG_MFD_RT5033_RESET_GPIO=y
CONFIG_MFD_RT5033_SLDO_VBUSDET=n
CONFIG_BATTERY_SAMSUNG=y
CONFIG_BATTERY_SAMSUNG_DATA_FILE="a5_battery_data.h"
CONFIG_SAMSUNG_LPM_MODE=y
CONFIG_CHARGER_RT5033=y
CONFIG_FUELGAUGE_RT5033=y
CONFIG_REGULATOR_RT5033=y
CONFIG_BATTERY_SWELLING=y
CONFIG_SIOP_CHARGING_LIMIT_CURRENT=700

#IPSec
CONFIG_CRYPTO_NULL=y

#MMC
CONFIG_SEC_HYBRID_TRAY=y

CONFIG_HID_SUPPORT=y
CONFIG_HID=y
CONFIG_HIDRAW=y

#IPSec
CONFIG_CRYPTO_NULL=y

# SSWAP
CONFIG_SWAP=y
CONFIG_FRONTSWAP=y
CONFIG_ZSMALLOC=y
CONFIG_PGTABLE_MAPPING=y
CONFIG_ZSWAP=y
CONFIG_DIRECT_RECLAIM_FILE_PAGES_ONLY=y
CONFIG_INCREASE_MAXIMUM_SWAPPINESS=y
CONFIG_FIX_INACTIVE_RATIO=y
CONFIG_TIGHT_PGDAT_BALANCE=y
CONFIG_VNSWAP=y
CONFIG_SWAP_ENABLE_READAHEAD=n

# ZRAM
CONFIG_ZRAM_LZ4_COMPRESS=y

# FAST CHARGE
CONFIG_FORCE_FAST_CHARGE=y
```
